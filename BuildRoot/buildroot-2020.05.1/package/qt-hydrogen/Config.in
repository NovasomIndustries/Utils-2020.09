## BuildRoot/buildroot-2020.05.1/package/qt-hydrogen/Config.in
```kconfig
config BR2_PACKAGE_QT_HYDROGEN
	bool "qt-hydrogen"
	depends on BR2_PACKAGE_QT5
	select BR2_PACKAGE_QT5BASE_GUI
	select BR2_PACKAGE_QT5WAYLAND
	select BR2_PACKAGE_QT5BASE_WIDGETS
	select BR2_PACKAGE_QT5MULTIMEDIA
	select BR2_PACKAGE_QT5XMLPATTERNS
	select BR2_PACKAGE_QT5TOOLS_LINGUIST_TOOLS
	select BR2_PACKAGE_QT5TOOLS_QDOC_TOOL
	select BR2_PACKAGE_QT5TOOLS_PIXELTOOL
	select BR2_PACKAGE_QT5TOOLS_QTDIAG
	select BR2_PACKAGE_QT5TOOLS_QTPATHS
	select BR2_PACKAGE_QT5TOOLS_QTPLUGININFO
	select BR2_PACKAGE_LIBLO
	select BR2_PACKAGE_LIBARCHIVE
	select BR2_PACKAGE_LIBSNDFILE
	help
		Hydrogen is a software drum synthesizer 

		git://github.com/hydrogen-music/hydrogen.git
```
